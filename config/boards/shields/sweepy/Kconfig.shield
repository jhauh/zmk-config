## config/boards/shields/sweepy/Kconfig.shield
```kconfig
# Copyright (c) 2020 The ZMK Contributors
# SPDX-License-Identifier: MIT

config SHIELD_SWEEPY_LEFT
	def_bool $(shields_list_contains,sweepy_left)

config SHIELD_SWEEPY_RIGHT
	def_bool $(shields_list_contains,sweepy_right)
```
